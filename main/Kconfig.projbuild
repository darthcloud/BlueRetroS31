## main/Kconfig.projbuild
```kconfig
menu "BlueRetro"

    config BLUERETRO_BT_DISABLE
        bool "Disable Bluetooth init"
        help
            Select this to disable Bluetooth init.

    config BLUERETRO_BT_EXTERNAL_H4
        bool "Use external BT radio"
        help
            Select this to use an external BT radio thought H4 UART interface.

    config BLUERETRO_BT_H4_TRACE
        bool "Enable Bluetooth H4 tracing"
        help
            Select this to enable Bluetooth H4 tracing.

    config BLUERETRO_BT_MON_VERBOSE
        bool "Enable verbose loggin into BT monitor"
        help
            Seclect this to enable verbose loggin into BT monitor.

    config BLUERETRO_BT_SSP_DBG
        bool "Enable Bluetooth SSP debug mode"
        help
            Select this to enable Bluetooth SSP debug mode.

    config BLUERETRO_COVERAGE
        bool "Enable gcov coverage logging"
        help
            Seclect this to enable gcov coverage logging.

    config BLUERETRO_ETH_CMDS
        bool "Enable ethernet cmds"
        help
            Select this to enable websocket cmds.

    config BLUERETRO_HID_REPORT_DEBUG
        bool "Enable HID report debug"
        help
            Select this to enable Generic HID report debug.

    config BLUERETRO_HID_DESC_DUMP
        bool "Enable HID descriptor dump"
        help
            Select this to dump HID descriptor.

    config BLUERETRO_QEMU
        bool "Enable QEMU friendly config"
        help
            Select this to make an image for QEMU.

    choice BLUERETRO_SYSTEM_INTERFACE
        bool "System interface selection"
        default BLUERETRO_SYSTEM_NONE
        help
            Select system interface.

        config BLUERETRO_SYSTEM_NONE
            bool "No system interface configured"
            help
                Select this to configure no system interface.

        config BLUERETRO_SYSTEM_WAVEPAK_VX
            bool "Enable WavePak Vectrex interface"
            help
                Select this to support WavePak Vectrex interface.

        config BLUERETRO_SYSTEM_XBOX
            bool "Enable OG Xbox USB interface"
            help
                Select this to support OG Xbox USB interface.

    endchoice

endmenu
```

## sdkconfig.defaults
```kconfig
#
# Bootloader config
#

#
# Application Rollback
#
CONFIG_BOOTLOADER_APP_ROLLBACK_ENABLE=y
# end of Application Rollback
# end of Bootloader config

#
# Serial flasher config
#
CONFIG_ESPTOOLPY_FLASHSIZE_16MB=y
# end of Serial flasher config

#
# Partition Table
#
CONFIG_PARTITION_TABLE_CUSTOM=y
CONFIG_PARTITION_TABLE_OFFSET=0x10000
# end of Partition Table

#
# Compiler options
#
CONFIG_COMPILER_OPTIMIZATION_PERF=y
# end of Compiler options

#
# Component config
#

#
# ESP-STDIO
#
CONFIG_ESP_CONSOLE_UART_CUSTOM=y
CONFIG_ESP_CONSOLE_UART_BAUDRATE=921600
# end of ESP-STDIO

#
# SPIFFS Configuration
#
CONFIG_SPIFFS_MAX_PARTITIONS=1
# end of SPIFFS Configuration
# end of Component config
```

## sdkconfig.defaults.esp32p4
```kconfig
#
# BlueRetro
#
CONFIG_BLUERETRO_BT_EXTERNAL_H4=y
# end of BlueRetro

#
# Component config
#

#
# Hardware Settings
#

#
# Chip revision
#
CONFIG_ESP32P4_SELECTS_REV_LESS_V3=y
CONFIG_ESP32P4_REV_MIN_100=y
# end of Chip revision
# end of Hardware Settings
# end of Component config
```

## sdkconfig.defaults.esp32s31
```kconfig
#
# Component config
#

#
# Bluetooth
#
CONFIG_BT_ENABLED=y
CONFIG_BT_CONTROLLER_ONLY=y

#
# Controller Options
#
CONFIG_BTDM_CTRL_MODE_BTDM=y
# end of Controller Options
# end of Bluetooth
# end of Component config
```
